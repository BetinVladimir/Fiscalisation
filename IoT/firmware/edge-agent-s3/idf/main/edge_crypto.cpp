#include "edge_runtime_port.h"
#include "mbedtls/ecdh.h"
#include "mbedtls/gcm.h"
#include "mbedtls/hkdf.h"
#include "mbedtls/md.h"

namespace beefiscal::idf { namespace {
constexpr uint8_t scalar[32]={0x77,0x07,0x6d,0x0a,0x73,0x18,0xa5,0x7d,0x3c,0x16,0xc1,0x72,0x51,0xb2,0x66,0x45,0xdf,0x4c,0x2f,0x87,0xeb,0xc0,0x99,0x2a,0xb1,0x77,0xfb,0xa5,0x1d,0xb9,0x2c,0x2a};
constexpr uint8_t peer[32]={0xde,0x9e,0xdb,0x7d,0x7b,0x7d,0xc1,0xb4,0xd3,0x5b,0x61,0xc2,0xec,0xe4,0x35,0x37,0x3f,0x83,0x43,0xc8,0x5b,0x78,0x67,0x4d,0xad,0xfc,0x7e,0x14,0x6f,0x88,0x2b,0x4f};
constexpr uint8_t shared_expected[32]={0x4a,0x5d,0x9d,0x5b,0xa4,0xce,0x2d,0xe1,0x72,0x8e,0x3b,0xf4,0x80,0x35,0x0f,0x25,0xe0,0x7e,0x21,0xc9,0x47,0xd1,0x9e,0x33,0x76,0xf0,0x9b,0x3c,0x1e,0x16,0x17,0x42};
constexpr uint8_t salt[32]={0x35,0xa3,0x25,0xde,0x3d,0x7b,0xbf,0x14,0xda,0xa5,0xe5,0xb2,0xb8,0x39,0x80,0x9c,0x9d,0x29,0xff,0x84,0x1c,0x66,0xd0,0xb6,0x3c,0x26,0xd4,0x1d,0x25,0xc5,0x64,0xb5};
constexpr char info[]="BeeFiscal BLE v1|tenant|location|register|edge|fiscal-device|session|2026-08-07";
constexpr uint8_t key_expected[32]={0x92,0x1b,0x0f,0xd8,0x4d,0x61,0x36,0xd7,0xef,0x44,0xad,0xde,0xea,0xd8,0x16,0xdc,0xf6,0xff,0xc7,0xd0,0x9e,0x2c,0xe7,0x51,0xec,0xe2,0x73,0x5f,0x41,0xb7,0xf2,0x36};
constexpr uint8_t nonce[12]={0,1,2,3,4,5,6,7,8,9,10,11};
constexpr uint8_t aad[]={0x42,0x65,0x65,0x46,0x69,0x73,0x63,0x61,0x6c,0x2d,0x67,0x6f,0x6c,0x64,0x65,0x6e,0x2d,0x61,0x61,0x64};
constexpr uint8_t plain[]={0x66,0x69,0x73,0x63,0x61,0x6c,0x2d,0x70,0x61,0x79,0x6d,0x65,0x6e,0x74};
constexpr uint8_t cipher_expected[]={0xae,0x87,0x36,0xa6,0xa6,0x64,0x8d,0x06,0xd7,0x0a,0x0c,0x34,0x2b,0xc5};
constexpr uint8_t tag_expected[16]={0xa1,0xbb,0x36,0xb2,0x88,0x4e,0x79,0xc9,0xdc,0x0a,0xfe,0x49,0xb6,0x98,0x01,0xc6};
bool equal(const uint8_t*a,const uint8_t*b,size_t n){uint8_t d=0;for(size_t i=0;i<n;i++)d|=a[i]^b[i];return d==0;}
esp_err_t x25519(uint8_t out[32]){mbedtls_ecp_group g;mbedtls_ecp_point q;mbedtls_mpi d,z;mbedtls_ecp_group_init(&g);mbedtls_ecp_point_init(&q);mbedtls_mpi_init(&d);mbedtls_mpi_init(&z);int r=mbedtls_ecp_group_load(&g,MBEDTLS_ECP_DP_CURVE25519);if(!r)r=mbedtls_mpi_read_binary_le(&d,scalar,32);if(!r)r=mbedtls_mpi_read_binary_le(&q.MBEDTLS_PRIVATE(X),peer,32);if(!r)r=mbedtls_mpi_lset(&q.MBEDTLS_PRIVATE(Z),1);if(!r)r=mbedtls_ecdh_compute_shared(&g,&z,&q,&d,nullptr,nullptr);if(!r)r=mbedtls_mpi_write_binary_le(&z,out,32);mbedtls_mpi_free(&z);mbedtls_mpi_free(&d);mbedtls_ecp_point_free(&q);mbedtls_ecp_group_free(&g);return r?ESP_FAIL:ESP_OK;}
}
esp_err_t crypto_self_test(){
  uint8_t shared[32]{};if(x25519(shared)!=ESP_OK||!equal(shared,shared_expected,32))return ESP_ERR_INVALID_CRC;
  uint8_t key[32]{};if(mbedtls_hkdf(mbedtls_md_info_from_type(MBEDTLS_MD_SHA256),salt,sizeof(salt),shared,sizeof(shared),(const uint8_t*)info,sizeof(info)-1,key,sizeof(key))||!equal(key,key_expected,32))return ESP_ERR_INVALID_CRC;
  uint8_t cipher[sizeof(plain)]{},tag[16]{};mbedtls_gcm_context g;mbedtls_gcm_init(&g);int r=mbedtls_gcm_setkey(&g,MBEDTLS_CIPHER_ID_AES,key,256);if(!r)r=mbedtls_gcm_crypt_and_tag(&g,MBEDTLS_GCM_ENCRYPT,sizeof(plain),nonce,sizeof(nonce),aad,sizeof(aad),plain,cipher,sizeof(tag),tag);mbedtls_gcm_free(&g);
  return !r&&equal(cipher,cipher_expected,sizeof(cipher))&&equal(tag,tag_expected,sizeof(tag))?ESP_OK:ESP_ERR_INVALID_CRC;
}
}
